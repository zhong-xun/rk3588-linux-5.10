## buildroot/package/rockchip/boardlab/Config.in
```kconfig
config BR2_PACKAGE_BOARDLAB
	bool "boardlab"
	depends on BR2_PACKAGE_QT5
	depends on BR2_PACKAGE_QT5_JSCORE_AVAILABLE
	depends on BR2_PACKAGE_QT5_GL_AVAILABLE
	depends on BR2_PACKAGE_WESTON
	select BR2_PACKAGE_QT5BASE
	select BR2_PACKAGE_QT5BASE_GUI
	select BR2_PACKAGE_QT5BASE_OPENGL
	select BR2_PACKAGE_QT5BASE_NETWORK
	select BR2_PACKAGE_QT5BASE_CONCURRENT
	select BR2_PACKAGE_QT5DECLARATIVE
	select BR2_PACKAGE_QT5DECLARATIVE_QUICK
	select BR2_PACKAGE_QT5QUICKCONTROLS2
	select BR2_PACKAGE_QT5WAYLAND
	select BR2_PACKAGE_UTIL_LINUX
	select BR2_PACKAGE_UTIL_LINUX_BINARIES
	select BR2_PACKAGE_GSTREAMER1
	select BR2_PACKAGE_GST1_PLUGINS_BASE
	select BR2_PACKAGE_GST1_PLUGINS_BASE_PLUGIN_APP
	# Rockchip's 4.19 SDK carries selectable GStreamer 1.18/1.20 trees
	# where videoconvert and videoscale are separate. Newer Buildroot trees
	# build both from the combined videoconvertscale option.
	select BR2_PACKAGE_GST1_PLUGINS_BASE_PLUGIN_VIDEOCONVERT if BR2_PACKAGE_GSTREAMER1_18 || BR2_PACKAGE_GSTREAMER1_20
	select BR2_PACKAGE_GST1_PLUGINS_BASE_PLUGIN_VIDEOSCALE if BR2_PACKAGE_GSTREAMER1_18 || BR2_PACKAGE_GSTREAMER1_20
	select BR2_PACKAGE_GST1_PLUGINS_BASE_PLUGIN_VIDEOCONVERTSCALE if !BR2_PACKAGE_GSTREAMER1_18 && !BR2_PACKAGE_GSTREAMER1_20
	select BR2_PACKAGE_GST1_PLUGINS_BASE_PLUGIN_PLAYBACK
	select BR2_PACKAGE_GST1_PLUGINS_BASE_PLUGIN_RAWPARSE
	select BR2_PACKAGE_GST1_PLUGINS_GOOD
	select BR2_PACKAGE_GST1_PLUGINS_GOOD_PLUGIN_AUTODETECT
	select BR2_PACKAGE_GST1_PLUGINS_GOOD_JPEG
	select BR2_PACKAGE_GST1_PLUGINS_GOOD_PLUGIN_MULTIFILE
	select BR2_PACKAGE_GST1_PLUGINS_GOOD_PLUGIN_V4L2
	help
	  BoardLab Qt Quick hardware lab for Rockchip Linux boards.
	  Live V4L2 previews use a GStreamer appsink inside the Qt
	  Quick window.

if BR2_PACKAGE_BOARDLAB

config BR2_PACKAGE_BOARDLAB_AUTOSTART
	bool "autostart BoardLab after Weston (S60)"
	default y
	help
	  Install SysV S60boardlab to launch BoardLab after Weston.

config BR2_PACKAGE_BOARDLAB_NPU
	bool "enable NPU YOLO demo support at build time"
	default n
	select BR2_PACKAGE_RKNPU2
	select BR2_PACKAGE_OPENCV4
	select BR2_PACKAGE_OPENCV4_LIB_IMGPROC
	select BR2_PACKAGE_OPENCV4_LIB_IMGCODECS
	select BR2_PACKAGE_OPENCV4_LIB_VIDEOIO
	select BR2_PACKAGE_OPENCV4_WITH_FFMPEG
	select BR2_PACKAGE_OPENCV4_WITH_GSTREAMER1
	select BR2_PACKAGE_OPENCV4_WITH_JPEG
	select BR2_PACKAGE_OPENCV4_WITH_PNG
	help
	  Build BoardLab with optional YOLOv8 RKNN support. The SDK's
	  own RKNPU2 runtime keeps userspace and kernel-driver ABIs
	  aligned.

endif
```
